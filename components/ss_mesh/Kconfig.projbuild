## components/ss_mesh/Kconfig.projbuild
```kconfig
menu "SS Forest Mesh Configuration"

    config MESH_CHANNEL
        int "Mesh channel"
        range 0 14
        default 0

    config MESH_ROUTER_SSID
        string "Router SSID"
        default "ROUTER_SSID"

    config MESH_ROUTER_PASSWD
        string "Router password"
        default "ROUTER_PASSWD"

    choice
        bool "Mesh AP Authentication Mode"
        default WIFI_AUTH_WPA2_PSK

        config WIFI_AUTH_OPEN
            bool "WIFI_AUTH_OPEN"
        config WIFI_AUTH_WPA_PSK
            bool "WIFI_AUTH_WPA_PSK"
        config WIFI_AUTH_WPA2_PSK
            bool "WIFI_AUTH_WPA2_PSK"
        config WIFI_AUTH_WPA_WPA2_PSK
            bool "WIFI_AUTH_WPA_WPA2_PSK"
    endchoice

    config MESH_AP_AUTHMODE
        int
        default 0 if WIFI_AUTH_OPEN
        default 2 if WIFI_AUTH_WPA_PSK
        default 3 if WIFI_AUTH_WPA2_PSK
        default 4 if WIFI_AUTH_WPA_WPA2_PSK

    config MESH_AP_PASSWD
        string "Mesh AP password"
        default "mesh_pass"

    config MESH_AP_CONNECTIONS
        int "Mesh AP child connections"
        range 1 10
        default 6

    config MESH_NON_MESH_AP_CONNECTIONS
        int "Mesh AP non-mesh connections"
        range 0 9
        default 0

    config MESH_IE_ENCRYPTED
        bool "Encrypt Mesh IE"
        default y

    config MESH_MAX_LAYER
        int "Mesh max layer"
        range 1 25
        default 6

    config MESH_ROUTE_TABLE_SIZE
        int "Mesh routing table size"
        range 1 300
        default 50

    config MESH_USE_GLOBAL_DNS_IP
        bool "Use global DNS IP"
        default n

    config MESH_GLOBAL_DNS_IP
        hex "Global DNS IP"
        depends on MESH_USE_GLOBAL_DNS_IP
        default 0x08080808

endmenu
```

## node/main/Kconfig.projbuild
```kconfig
menu "SS Forest Node Configuration"

    config SS_BUTTON_GPIO
        int "Button GPIO"
        default 4

    config SS_LED_GPIO
        int "WS2812B GPIO"
        default 20

    config SS_LED_COUNT
        int "WS2812B LED count"
        range 1 32
        default 2

    config SS_BLE_SCAN_SECONDS
        int "BLE scan duration seconds"
        range 1 30
        default 5

    config SS_BLE_MAX_DISTANCE_CM
        int "Accepted BLE distance cm"
        range 10 1000
        default 100

    config SS_BLE_RSSI_AT_ONE_METER
        int "RSSI at 1 meter calibration"
        range -100 -20
        default -59

    config SS_BLE_PATH_LOSS_EXPONENT_X10
        int "BLE path loss exponent x10"
        range 10 60
        default 20

    config SS_ROOT_RESPONSE_TIMEOUT_MS
        int "Root response timeout ms"
        range 1000 60000
        default 20000

    config SS_BLE_GATT_DEVICE_NAME
        string "BLE GATT device name"
        default "SS-FOREST-NODE"

endmenu
```

## node/sdkconfig.defaults
```kconfig
CONFIG_IDF_TARGET="esp32c3"
CONFIG_LWIP_L2_TO_L3_COPY=y
CONFIG_LWIP_IP_FORWARD=y
CONFIG_LWIP_IPV4_NAPT=y
CONFIG_LWIP_TCP_MSS=624
CONFIG_LWIP_TCP_OVERSIZE_MSS=y
CONFIG_PARTITION_TABLE_CUSTOM=y
CONFIG_PARTITION_TABLE_CUSTOM_FILENAME="partitions.csv"
CONFIG_PARTITION_TABLE_FILENAME="partitions.csv"
CONFIG_PARTITION_TABLE_OFFSET=0x8000
CONFIG_PARTITION_TABLE_MD5=y
CONFIG_COMPILER_OPTIMIZATION_SIZE=y
CONFIG_BT_ENABLED=y
CONFIG_BT_NIMBLE_ENABLED=y
CONFIG_BT_NIMBLE_ROLE_OBSERVER=y
CONFIG_MESH_ROUTER_SSID="FOREST_ROUTER"
CONFIG_MESH_ROUTER_PASSWD="FOREST_PASSWORD"
CONFIG_MESH_AP_PASSWD="forest_mesh"
```

## root/main/Kconfig.projbuild
```kconfig
menu "SS Forest Root Configuration"

    config SS_ROOT_DEFAULT_RESPONSE
        string "Default root response"
        default "OK"

endmenu
```

## root/sdkconfig.defaults
```kconfig
CONFIG_IDF_TARGET="esp32"
CONFIG_COMPILER_OPTIMIZATION_SIZE=y
CONFIG_ESP_CONSOLE_UART_DEFAULT=y
CONFIG_CONSOLE_UART_DEFAULT=y
CONFIG_LIBC_STDIN_LINE_ENDING_CRLF=y
CONFIG_NEWLIB_STDIN_LINE_ENDING_CRLF=y
CONFIG_MESH_ROUTER_SSID="FOREST_ROUTER"
CONFIG_MESH_ROUTER_PASSWD="FOREST_PASSWORD"
CONFIG_MESH_AP_PASSWD="forest_mesh"
```
